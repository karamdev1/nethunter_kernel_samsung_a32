## drivers/net/wireless/realtek/rtl8821cu/Kconfig
```kconfig
config RTL88XX
	tristate "Realtek 88XX USB WiFi"
	depends on USB
	help
	  Help message of RTL8821CU
```

## drivers/net/wireless/realtek/rtw88/Kconfig
```kconfig
config RTW88
	tristate "Realtek RTW88 USB WiFi"
	depends on USB
	help
	  Help message of RTW88
```
